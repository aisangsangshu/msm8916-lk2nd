// SPDX-License-Identifier: BSD-3-Clause

#include <skeleton64.dtsi>
#include <lk2nd.dtsi>

/ {
	qcom,msm-id = <0x116 0>;
	qcom,board-id = <0x08 0>;
};

&lk2nd {

		model = "Nubia Z11 Max (NX523J)";
		compatible = "nubia,nx523j";
		lk2nd,match-device = "NX523J*";
		qcom,mdss_dsi_samsung_s6e3fa3x01_1080p_5p2_command{
			compatible = "samsung,s6e3fa3x01-1080p-5p2";
			};
		// 若有面板信息可补充，否则留空
		// panel {
		// 	compatible = "nubia,nx523j-panel", "lk2nd,panel";
		// };

}; 